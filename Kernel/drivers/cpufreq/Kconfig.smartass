## Kernel/drivers/cpufreq/Kconfig.smartass
```kconfig
# drivers/cpufreq/Kconfig.smartass
#

if CPU_FREQ_GOV_SMARTASS

config SMARTASS_SLEEP_MAX
	int "Sleep Max Freq"
	default 800000
	depends on CPU_FREQ_GOV_SMARTASS
	help
	  When sleep_max_freq>0 the frequency when suspended will be capped
	  by this frequency. Also will wake up at max frequency of policy
	  to minimize wakeup issues.
	  Set sleep_max_freq=0 to disable this behavior.

config SMARTASS_SLEEP_WAKEUP
	int "Sleep Wakeup Freq"
	default 1000000
	depends on CPU_FREQ_GOV_SMARTASS
	help
	  The frequency to set when waking up from sleep.
	  When sleep_max_freq=0 this will have no effect.

config SMARTASS_DEFAULT_SAMPLE_RATE_JIFFIES
	int "Default sample rate jiffies"
	default 2
	depends on CPU_FREQ_GOV_SMARTASS
	help
	  Sampling rate, I highly recommend to leave it at 2.

config SMARTASS_DEFAULT_RAMP_UP_STEP
	int "Default ramp up step"
	default 500000
	depends on CPU_FREQ_GOV_SMARTASS
	help
	  Freqeuncy delta when ramping up.
	  zero disables causes to always jump straight to max frequency.

config SMARTASS_DEFAULT_RAMP_DOWN_STEP
	int "Default ramp down step"
	default 500000
	depends on CPU_FREQ_GOV_SMARTASS
	help
	  Max freqeuncy delta when ramping down. zero disables.

config SMARTASS_DEFAULT_MAX_CPU_LOAD
	int "Default max cpu load"
	default 50
	depends on CPU_FREQ_GOV_SMARTASS
	help
	  CPU freq will be increased if measured load > max_cpu_load;

config SMARTASS_DEFAULT_MIN_CPU_LOAD
	int "Default min cpu load"
	default 25
	depends on CPU_FREQ_GOV_SMARTASS
	help
	  CPU freq will be decreased if measured load < min_cpu_load;

config SMARTASS_DEFAULT_UP_RATE_US
	int "Default up rate in us"
	default 24000
	depends on CPU_FREQ_GOV_SMARTASS
	help
	  The minimum amount of time to spend at a frequency before we can ramp up.

config SMARTASS_DEFAULT_DOWN_RATE_US
	int "Default down rate in us"
	default 49000
	depends on CPU_FREQ_GOV_SMARTASS
	help
	  The minimum amount of time to spend at a frequency before we can ramp down.

config SMARTASS_DEFAULT_UP_MIN_FREQ
	int "Default up minimum frequency"
	default 1000000
	depends on CPU_FREQ_GOV_SMARTASS
	help
	  When ramping up frequency with no idle cycles jump to at least this frequency.
	  Zero disables. Set a very high value to jump to policy max freqeuncy.

config SMARTASS_DEFAULT_AWAKE_MIN_FREQ
	int "Default awake minimum frequency"
	default 200000
	depends on CPU_FREQ_GOV_SMARTASS
	help
	  When awake_min_freq>0 the frequency when not suspended will not
	  go below this frequency.
	  Set awake_min_freq=0 to disable this behavior.

config SMARTASS_DEFAULT_DEBUG_MASK
	int "Default setting for debugging"
	default 0
	depends on CPU_FREQ_GOV_SMARTASS
	help
	  Debug values, set 0 = off, 1 = SMARTASS_DEBUG_JUMPS, 2 = SMARTASS_DEBUG_LOAD,
	  3 = Both of the above

endif
```

## Kernel/kernel/nubernel/Kconfig
```kconfig
# kernel/nubernel/Kconfig
#
# nubecoder 2011
#
# Licensed under GPLv2

config NUBERNEL_SYSFS
	bool "Nubernel parent Kset"
	depends on SYSFS
	default y
	help
		Adds a sysfs folder "/sys/nubernel"

source "kernel/nubernel/Kconfig.battery"
```

## Kernel/kernel/nubernel/Kconfig.battery
```kconfig
# kernel/nubernel/Kconfig.battery
#
# nubecoder 2011
#
# Licensed under GPLv2

if NUBERNEL_SYSFS

config NUBERNEL_CHARGE_CONTROL_SYSFS
	bool "Battery full charge control via sysfs"
	depends on NUBERNEL_SYSFS && SYSFS
	default y
	help
		Adds a sysfs folder "/sys/nubernel/chargecontrol"

config NUBERNEL_FUEL_GAUGE_SYSFS
	bool "Battery percentage control via sysfs"
	depends on NUBERNEL_SYSFS && SYSFS
	default y
	help
		Adds a sysfs folder "/sys/nubernel/fuelgauge"

config NUBERNEL_CHARGE_RATE_SYSFS
	bool "Battery charge rate control via sysfs"
	depends on NUBERNEL_SYSFS && SYSFS
	default y
	help
		Adds a sysfs folder "/sys/nubernel/chargerate"

endif
```
